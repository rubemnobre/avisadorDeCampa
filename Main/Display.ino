#include<EEPROM.h>

const int xdim = 5; //
const int ydim = 7; //Resolucao

const String nome[24] = //Nomes das materias
{"bio", "ef ", "el2", "ed ", "e2 ", "fil", "fis", "geo", "his", "mat", "qui", "soc", "por", "art", "ing", "ons", "tc1", "tc2", "tc3", "tc4", "tc5", "tut", "alm", "int"};

const uint8_t PROGMEM fonte[96][7] = {  //Fonte para a matriz
	0x00, 0x00, 0x00, 0x00, 0x00, 0x00, 0x00,   // 0x20, Space
	0x04, 0x04, 0x04, 0x04, 0x04, 0x00, 0x04,   // 0x21, !
	0x09, 0x09, 0x12, 0x00, 0x00, 0x00, 0x00,   // 0x22, "
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	0x1f, 0x1f, 0x1f, 0x1f, 0x1f, 0x1f, 0x1f,   // 0x7f, DEL
};

int show[ydim][nchars * xdim];

void paramatriz(String text) //Esta funcao recebe uma string, a transforma em uma dotmatrix e coloca na matriz de display
{
	text = text + "  ";
	char chars[nchars + 1];
	text.toCharArray(chars, nchars);
	strupr(chars);
	for (int i = 0; i < nchars; i++) {
		for (int k = 0; k < ydim; k++) {
			for (int j = 0; j < xdim; j++) {
				show[k][i * xdim + j] = bitRead(pgm_read_word(&fonte[(int)chars[i] - 0x20][k]), xdim - 1 - j);
			}
		}
	}
}

int promw() //Esta funcao grava os tempos padrao na memoria nao volatil
{
	for (int i = 0; i < ndias; i++) {
		for (int j = 0; j < ntempos; j++) {
			EEPROM.write(i * ntempos + j, sembe[i][j]);
		}
	}
	return 0;
}

int promr() //Esta funcao le os dados de tempo da memoria nao volatil
{
  for (int i = 0; i < ndias; i++) {
    for (int j = 0; j < ntempos; j++) {
      semana[i][j] = EEPROM.read(i * ntempos + j);
    }
  }
  return 0;
}

void shift(int dat) //Esta funcao desloca um bit para os registros de deslocamento do display
{
	if (dat == 1) {
		digitalWrite(pinser, HIGH);
		digitalWrite(pinclk, HIGH);
		digitalWrite(pinclk, LOW);
		digitalWrite(pinser, LOW);
	} else {
		digitalWrite(pinser, LOW);
		digitalWrite(pinclk, HIGH);
		digitalWrite(pinclk, LOW);
		digitalWrite(pinser, LOW);
	}
	digitalWrite(pinlat, LOW);
	digitalWrite(pinlat, HIGH);
}

void disp() //Esta funcao transfere a dotmatrix para os registros do display
{
	for (int i = 0; i < ydim; i++) {
		for (int j = 0; j < ydim; j++) {
			if (i == j) {
				shift(1);
			} else {
				shift(0);
			}
		}
		for (int j = 0; j < xdim * (nchars - 1); j++) {
			shift(show[i][j] ? 0 : 1);
		}
		digitalWrite(pinoud, LOW);
		delayMicroseconds(dispdelay);
		digitalWrite(pinoud, HIGH);
	}
}

void disptempo(int dianow, int tempo){ //Esta funcao recebe o tempo atual e manda a string equivalente para o display
  String ntempo;
      if (tempo == ntempos - 1) {
        ntempo = "fim";
      } else {
        ntempo = nome[semana[dianow][tempo + 1]];
      }
      paramatriz(ntempo);
}

