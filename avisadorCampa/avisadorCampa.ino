#include <RTClib.h>
#include<EEPROM.h>
#include<Wire.h>

RTC_DS1307 rtc; //objeto do rtc

//MatÃ©rias
const int bio = 0;
const int ef = 1;
const int el2 =  2;
const int ed = 3;
const int e2 = 4;
const int fil = 5;
const int fis = 6;
const int geo = 7;
const int his = 8;
const int mat = 9;
const int qui = 10;
const int soc = 11;
const int por = 12;
const int art = 13;
const int ing = 14;
const int ons = 15;
const int tut = 21;
const int alm = 22;
const int ite = 23;
const int pre = 24;

const long int minms = 60000; //DuraÃ§Ã£o de um minuto em ms (para teste)
const char chamada = 'e'; //Comando serial que inicia a entrada de dados
const char calltempo = 't'; //Comando serial que inicia a entrada de dados
const int ntempos = 11; //Contando com intervalo, almoÃ§o e tutoria
const int ndias = 5; // Po
const int setpin = 2; //Pino do botÃ£o set
const int tbounce = 20; //Tempo para debounce do botÃ£o
const int nchars = 4;
const int xdim = 5;
const int ydim = 7;
const int initmin = 435;
const int pinlat = 6;
const int pinclk = 5;
const int pinser = 7;
const int pinoud = 4;
int dispdelay = 3000;

const int neg = 2; //1 para anodo na linha, 0 para anodo na coluna

const String nome[24] =
{"bio", "ef ", "el2", "ed ", "e2 ", "fil", "fis", "geo", "his", "mat", "qui", "soc", "por", "art", "ing", "ons", "tc1", "tc2", "tc2", "tc3", "tc4", "tut", "alm", "int"};

const uint8_t PROGMEM fonte[96][7] = {
	0x00, 0x00, 0x00, 0x00, 0x00, 0x00, 0x00,   // 0x20, Space
	0x04, 0x04, 0x04, 0x04, 0x04, 0x00, 0x04,   // 0x21, !
	0x09, 0x09, 0x12, 0x00, 0x00, 0x00, 0x00,   // 0x22, "
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	0x1f, 0x1f, 0x1f, 0x1f, 0x1f, 0x1f, 0x1f,   // 0x7f, DEL
};

int show[ydim][nchars * xdim];

void paramatriz(String text)
{
	text = text + "  ";
	char chars[nchars + 1];
	text.toCharArray(chars, nchars);
	strupr(chars);
	for (int i = 0; i < nchars; i++) {
		for (int k = 0; k < ydim; k++) {
			for (int j = 0; j < xdim; j++) {
				show[k][i * xdim + j] = bitRead(pgm_read_word(&fonte[(int)chars[i] - 0x20][k]), xdim - 1 - j);
			}
		}
	}
}

int sembe[ndias][ntempos] = {
	pre, art, his, ite,  bio, mat, tut, alm, ing, fil, por,
	pre,  e2,  e2, ite,  mat,  ef, tut, alm, qui, por, fis,
	pre,  e2, mat, ite,  el2, his, tut, alm, fis, el2, ons,
	pre, soc, geo, ite,  ing,  ef, tut, alm, por,  ed,  ed,
	pre,  ed,  ed, ite,  bio, fis, tut, alm, qui, mat, por
};

int semana[ndias][ntempos];

int dianow = -1, tempo = 0, minuto = 0, segundo = 0;

void set()
{
	dianow++;
	dianow %= ndias;
	tempo = 0;
	minuto = 0;
}

long now;
long int agr = 0, agora = 0;

void checkevent();

void rectempo()
{
	long msread = 0, diaread = 0;
	msread = Serial.readStringUntil('~').toInt();
	String s = Serial.readStringUntil('~');
	diaread = s.toInt();
	Serial.println("G");
	settime(msread, diaread);
}

void settime(long msread, long diaread)
{
	long twait = 0;
	agora = millis();
	agr = millis();
	digitalWrite(13, HIGH);
	segundo = (msread % minms) / 1000;
	if (diaread - 1 < 5) {
		if (msread / minms >= initmin && msread / minms <= initmin + totaldia(diaread - 1) / minms) {
			int mn = 0, tmp = 0, m = 0;
			do {
				mn++;
				m++;
				if (mn == duracao(semana[diaread - 1][tmp])) {
					mn = 0;
					tmp++;
				}
			} while (m != (msread / minms) - initmin);
			tempo = tmp;
			minuto = mn;
			dianow = diaread - 1;
		} else {
			if (msread / minms > initmin) {
				twait = (24 * 60 * minms) - msread;
				dianow = diaread;
			} else {
				twait = initmin * minms - msread;
				dianow = diaread - 1;
			}
			while (agora - agr <= twait) {
				agora = millis();
				checkevent();
			}
			agora = 0;
			agr = 0;
			tempo = 0;
			minuto = 0;
			segundo = 0;
		}
	} else {
		twait = (24 * 60 * minms) * (8 - diaread) + initmin * minms - msread;
		while (agora - agr <= twait) {
			agora = millis();
			checkevent();
		}
		agora = 0;
		agr = 0;
		tempo = 0;
		minuto = 0;
		segundo = 0;
	}
	digitalWrite(13, LOW);
}

void proxdia()
{
	//espera ue
	agr = millis();
	dianow++;
	dianow %= ndias;
	minuto = 0;
	tempo = 0;
	segundo = 0;
	long int twait;
	if (dianow == 0) {
		twait = (24 * 60 * minms) * 3 - totaldia(dianow - 1);
	} else {
		twait = (24 * 60 * minms) - totaldia(dianow - 1);
	}
	digitalWrite(13, HIGH);
	while (agora - agr <= twait) {
		agora = millis();
	}
	digitalWrite(13, LOW);
	agora = 0;
	agr = 0;
}

long int totaldia(int day)
{
	int t = 0;
	for (int i = 0; i < ntempos; i++) {
		t += duracao(semana[day][i]);
	}
	return t * minms;
}

int promw()
{
	for (int i = 0; i < ndias; i++) {
		for (int j = 0; j < ntempos; j++) {
			EEPROM.write(i * ntempos + j, sembe[i][j]);
		}
	}
	return 0;
}

void shift(int dat)
{
	if (dat == 1) {
		digitalWrite(pinser, HIGH);
		digitalWrite(pinclk, HIGH);
		digitalWrite(pinclk, LOW);
		digitalWrite(pinser, LOW);
	} else {
		digitalWrite(pinser, LOW);
		digitalWrite(pinclk, HIGH);
		digitalWrite(pinclk, LOW);
		digitalWrite(pinser, LOW);
	}
	digitalWrite(pinlat, LOW);
	digitalWrite(pinlat, HIGH);
}

void disp()
{
	for (int i = 0; i < ydim; i++) {
		for (int j = 0; j < ydim; j++) {
			if (i == j) {
				shift(1);
			} else {
				shift(0);
			}
		}
		for (int j = 0; j < xdim * (nchars - 1); j++) {
			shift(show[i][j] ? 0 : 1);
		}
		digitalWrite(pinoud, LOW);
		delayMicroseconds(dispdelay);
		digitalWrite(pinoud, HIGH);
	}
}

void entradavs()
{
	int tmp = -1, dia = -1, mat = -1;
	String t, d, m;
	m = Serial.readStringUntil('~');
	mat = m.toInt();
	t = Serial.readStringUntil('~');
	tmp = t.toInt();
	d = Serial.readStringUntil('~');
	dia = d.toInt();
	Serial.println("G");
	if (mat != -1 && dia != -1 && tmp != -1) {
		sembe[dia][tmp] = mat;
		promw();
		promr();
	} else {
		if (dia == -1) {
			digitalWrite(13, HIGH);
		}
	}
}

void entrada()
{
	for (int i = 0; i < ndias; i++) {
		for (int j = 0; j < ntempos; j++) {
			String m1 = "Digite o tempo ";
			String m2 = " do dia ";
			String mensagem = m1 + j + m2 + i;
			Serial.println(mensagem);
			int a;
			while (Serial.available() == 0) {
				a++;
				if (a == 100000) {
					break;
				}
			}
			String in = Serial.readString();
			sembe[i][j] = in.toInt();
			Serial.println(sembe[i][j]);
		}
	}
	dianow = -1;
	set();
	promw();
}

void waitserial()
{
	int a;
	long t = millis();
	while (Serial.available() <= 0) {
		long t2 = millis();
		if (t2 - t >= 1000) {
			break;
		}
	}
}

void changedelay()
{
	dispdelay = Serial.readStringUntil('~').toInt();
}

void reset()
{
	if (Serial.readStringUntil('~') == "eset") {
		promw();
		promr();
	}
}

void syncrtc(){
	int ano  = Serial.readStringUntil('~').toInt();
	int mes  = Serial.readStringUntil('~').toInt();
	int dia  = Serial.readStringUntil('~').toInt();
	int hor  = Serial.readStringUntil('~').toInt();
	int min  = Serial.readStringUntil('~').toInt();
	int sec  = Serial.readStringUntil('~').toInt();
	DateTime tempo = DateTime(ano,mes,dia,hor,min,sec);
	rtc.adjust(tempo);
}

void checkevent()
{
	if (Serial.available()) {
		char a = Serial.read();
		if (a == chamada) {
			entrada();
		}
		if (a == calltempo) {
			rectempo();
		}
		if (a == 's') {
			entradavs();
		}
		if (a == 'd') {
			changedelay();
		}
		if (a == 'r') {
			reset();
		}
		if (a == 'c') {
			syncrtc();
		}
		if (a == 'h') {
			Serial.println(rtc.now().unixtime());
		}
	}
}

int duracao(int tipo)
{
	if (tipo == ite) {
		return 20;
	}
	if (tipo == tut) {
		return 60;
	}
	if (tipo == pre) {
		return 15;
	}
	return 50;
}
int promr()
{
	for (int i = 0; i < ndias; i++) {
		for (int j = 0; j < ntempos; j++) {
			semana[i][j] = EEPROM.read(i * ntempos + j);
		}
	}
	return 0;
}

long int tset = 0, ltset = 0, temp = 0;
long int ltmin = 0;
int setprev = 0;

void intset()
{
	temp = millis();
	if (temp - ltset >= tbounce) {
		set();
	}
	ltset = temp;
	agr = totaldia(dianow);
}

long timeshow = 3000, ltshow = 0, st = 0;

void update()
{
	temp = millis();
	if (temp - ltmin >= 1000) {
		Serial.print(duracao(semana[dianow][tempo]) - minuto);
		Serial.print(" ");
		Serial.println(nome[semana[dianow][tempo + 1]]);
		segundo++;
		if (segundo == minms / 1000) {
			minuto++;
			segundo = 0;
		}
		if (minuto == duracao(semana[dianow][tempo])) {
			minuto = 0;
			tempo++;
			if (tempo == ntempos) {
				proxdia();
			}
		}
		ltmin = temp;
	}
	if (temp - ltshow >= timeshow) {
		if (st == 0) {
			String ntempo;
			if (tempo == ntempos - 1) {
				ntempo = "fim";
			} else {
				ntempo = nome[semana[dianow][tempo + 1]];
			}
			paramatriz(ntempo);
			st = 1;
		} else {
			if (st == 1) {
				paramatriz(String(duracao(semana[dianow][tempo]) - minuto) + " ");
				st = 0;
			}
		}
		ltshow = temp;
	}
}

void setup()
{
	//promw();
	promr();
	Serial.begin(9600);
	Wire.begin();
	rtc.begin();
	set();
	long msnow, dow;
	DateTime agr = rtc.now();
	dow = agr.dayOfTheWeek();
	Serial.println(agr.unixtime());
	msnow = (long)agr.unixtime() % (long)86400;
	Serial.println(msnow);
	msnow *= 1000;
	Serial.println(msnow);
	set();
	settime(msnow, dow);
	pinMode(setpin, INPUT_PULLUP);
	pinMode(13, OUTPUT);
	pinMode(pinlat, OUTPUT);
	pinMode(pinclk, OUTPUT);
	pinMode(pinser, OUTPUT);
	pinMode(pinoud, OUTPUT);
	digitalWrite(13, LOW);
	digitalWrite(pinoud, LOW);
	attachInterrupt(digitalPinToInterrupt(setpin), intset, FALLING);
}

void loop()
{
	disp();
	update();
}

void serialEvent()
{
	checkevent();
}
